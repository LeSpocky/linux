## Documentation/devicetree/bindings/leds/leds-pwm.yaml
```yaml
# SPDX-License-Identifier: GPL-2.0-only
%YAML 1.2
---
$id: http://devicetree.org/schemas/leds/leds-pwm.yaml#
$schema: http://devicetree.org/meta-schemas/core.yaml#

title: LEDs connected to PWM

maintainers:
  - Pavel Machek <pavel@ucw.cz>

description:
  Each LED is represented as a sub-node of the pwm-leds device.  Each
  node's name represents the name of the corresponding LED.

properties:
  compatible:
    const: pwm-leds

patternProperties:
  "^pwm-led-([0-9a-f])$":
    type: object

    $ref: common.yaml#

    properties:
      pwms:
        description:
          "PWM property to point to the PWM device (phandle)/port (id)
          and to specify the period time to be used:
          <&phandle id period_ns>;"

      pwm-names:
        description:
          "Name to be used by the PWM subsystem for the PWM device For
          the pwms and pwm-names property please refer to:
          Documentation/devicetree/bindings/pwm/pwm.txt"

      max-brightness:
        description:
          Maximum brightness possible for the LED

      active-low:
        description:
          For PWMs where the LED is wired to supply rather than ground.

    required:
      - pwms
      - max-brightness

examples:
  - |

    #include <dt-bindings/leds/common.h>

    twl_pwm: pwm {
        /* provides two PWMs (id 0, 1 for PWM1 and PWM2) */
        compatible = "ti,twl6030-pwm";
        #pwm-cells = <2>;
    };

    twl_pwmled: pwmled {
        /* provides one PWM (id 0 for Charing indicator LED) */
        compatible = "ti,twl6030-pwmled";
        #pwm-cells = <2>;
    };

    pwm_leds {
        compatible = "pwm-leds";

        pwm-led-1 {
            label = "omap4::keypad";
            pwms = <&twl_pwm 0 7812500>;
            max-brightness = <127>;
        };

        pwm-led-2 {
            color = <LED_COLOR_ID_GREEN>;
            function = LED_FUNCTION_CHARGING;
            pwms = <&twl_pwmled 0 7812500>;
            max-brightness = <255>;
        };
    };

...
```

## Documentation/devicetree/bindings/usb/atmel,at91-udc.yaml
```yaml
# SPDX-License-Identifier: (GPL-2.0-only OR BSD-2-Clause)
%YAML 1.2
---
$id: http://devicetree.org/schemas/usb/atmel,at91-udc.yaml#
$schema: http://devicetree.org/meta-schemas/core.yaml#

title: AT91 USB Device Controller

maintainers:

# Felipe Balbi <balbi@kernel.org> (maintainer:USB GADGET/PERIPHERAL SUBSYSTEM)
# Greg Kroah-Hartman <gregkh@linuxfoundation.org> (supporter:USB SUBSYSTEM)
# Nicolas Ferre <nicolas.ferre@microchip.com> (supporter:ARM/Microchip (AT91) SoC support)
# Alexandre Belloni <alexandre.belloni@bootlin.com> (supporter:ARM/Microchip (AT91) SoC support)
# Ludovic Desroches <ludovic.desroches@microchip.com> (supporter:ARM/Microchip (AT91) SoC support)
# linux-usb@vger.kernel.org (open list:USB GADGET/PERIPHERAL SUBSYSTEM)
# linux-arm-kernel@lists.infradead.org (moderated list:ARM/Microchip (AT91) SoC support)
# linux-kernel@vger.kernel.org (open list)

properties:
  compatible:
    enum:
      - atmel,at91rm9200-udc
      - atmel,at91sam9260-udc
      - atmel,at91sam9261-udc
      - atmel,at91sam9263-udc
```

## Documentation/devicetree/bindings/usb/atmel,at91rm9200-ohci.yaml
```yaml
# SPDX-License-Identifier: (GPL-2.0-only OR BSD-2-Clause)
%YAML 1.2
---
$id: http://devicetree.org/schemas/usb/atmel,at91rm9200-ohci.yaml#
$schema: http://devicetree.org/meta-schemas/core.yaml#

title: Atmel/Microchip SoC USB OHCI Host Controller

maintainers:

# Alan Stern <stern@rowland.harvard.edu> (maintainer:USB OHCI DRIVER)
# Greg Kroah-Hartman <gregkh@linuxfoundation.org> (supporter:USB SUBSYSTEM)
# Nicolas Ferre <nicolas.ferre@microchip.com> (supporter:ARM/Microchip (AT91) SoC support)
# Alexandre Belloni <alexandre.belloni@bootlin.com> (supporter:ARM/Microchip (AT91) SoC support)
# Ludovic Desroches <ludovic.desroches@microchip.com> (supporter:ARM/Microchip (AT91) SoC support)
# linux-usb@vger.kernel.org (open list:USB OHCI DRIVER)
# linux-arm-kernel@lists.infradead.org (moderated list:ARM/Microchip (AT91) SoC support)
# linux-kernel@vger.kernel.org (open list)

properties:
  compatible:
    const: atmel,at91rm9200-ohci
```

## Documentation/devicetree/bindings/usb/atmel,at91sam9g45-ehci.yaml
```yaml
# SPDX-License-Identifier: (GPL-2.0-only OR BSD-2-Clause)
%YAML 1.2
---
$id: http://devicetree.org/schemas/usb/atmel,at91sam9g45-ehci.yaml#
$schema: http://devicetree.org/meta-schemas/core.yaml#

title: Atmel/Microchip SoC USB EHCI Host Controller

maintainers:
  - Someone™ <kernel@example.com>

# Alan Stern <stern@rowland.harvard.edu> (maintainer:USB EHCI DRIVER)
# Greg Kroah-Hartman <gregkh@linuxfoundation.org> (supporter:USB SUBSYSTEM)
# Nicolas Ferre <nicolas.ferre@microchip.com> (supporter:ARM/Microchip (AT91) SoC support)
# Alexandre Belloni <alexandre.belloni@bootlin.com> (supporter:ARM/Microchip (AT91) SoC support)
# Ludovic Desroches <ludovic.desroches@microchip.com> (supporter:ARM/Microchip (AT91) SoC support)
# linux-usb@vger.kernel.org (open list:USB EHCI DRIVER)
# linux-arm-kernel@lists.infradead.org (moderated list:ARM/Microchip (AT91) SoC support)
# linux-kernel@vger.kernel.org (open list)

properties:
  compatible:
    const: atmel,at91sam9g45-ehci

  reg:
    maxItems: 1
    description:
      Address and length of the register set for the device.

  interrupts:
    maxItems: 1
    description:
      Should contain ehci interrupt.

  clocks:
    description:
      Should reference the peripheral and the UTMI clocks.
    items:
      - description: usb_clk for the UTMI clock
      - description: ehci_clk for the peripheral clock

  clock-names:
    items:
      - const: usb_clk
      - const: ehci_clk

additionalProperties: false

examples:
  - |

    usb1: usb@800000 {
        compatible = "atmel,at91sam9g45-ehci", "usb-ehci";
        reg = <0x00800000 0x100000>;
        interrupts = <22 4>;
        clocks = <&utmi>, <&uhphs_clk>;
        clock-names = "usb_clk", "ehci_clk";
    };

...
```
